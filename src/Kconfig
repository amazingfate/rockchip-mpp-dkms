## src/Kconfig
```kconfig
# SPDX-License-Identifier: (GPL-2.0+ OR MIT)

menuconfig ROCKCHIP_MPP_SERVICE
	tristate "mpp service framework"
	default m
	depends on ARCH_ROCKCHIP
	help
	  rockchip mpp service framework.

if ROCKCHIP_MPP_SERVICE

config ROCKCHIP_MPP_PROC_FS
	bool "mpp service procfs"
	depends on PROC_FS
	default y
	help
	  rockchip mpp service procfs.

config ROCKCHIP_MPP_RKVENC2
	bool "RKV encoder v2 device driver"
	default y
	help
	  rockchip mpp rkv combo encoder v2.

endif
```
